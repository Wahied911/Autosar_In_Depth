AUTOSAR XML (schema 00046)
package /SWCs_EABS
  sensor actuator sw component type SWC1_Lidar_Sensor
  sensor actuator sw component type SWC2_Speed_Sensor
  ecu abstraction sw component type SWC3_ECU_Abstracrt
  application sw component type SWC4_Application_Algorithm
  parameter sw component type SWC5_Distance_Parameters
  sensor actuator sw component type SWC6_Wairning_LED
  complex device driver sw component type SWC7_Break
  service sw component type SWC8_Service_For_Diagnostics_Manger
  nv block sw component type SWC9_NVM
