AUTOSAR XML (schema 00046)
package /CR_Lab
  client server interface CS1
    operation Get_Sum
      arg V1: type=uint16, direction=IN
      arg V2: type=uint16, direction=IN
      arg Result: type=uint32, direction=OUT
  application sw component type App1_SWC
    provide port Server: client-server-annotation=Get_Sum, provided-interface=CR_Lab
  application sw component type App2_SWC
    require port Client: client-server-annotation=Get_Sum, required-interface=CR_Lab
