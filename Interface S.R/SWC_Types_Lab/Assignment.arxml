AUTOSAR XML (schema 00046)
package /Lidar_System
  sender receiver interface SRI1
    data Lidar_Object_Distance: type=uint32, init-value=0
  application sw component type Lidar_App
    provide port Provider_Port: provided-interface=SRI1
  application sw component type DashBoard
    require port Reciver_port: required-interface=SRI1
