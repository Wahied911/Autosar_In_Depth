AUTOSAR XML (schema 00046)
package /Lidar_System
  sender receiver interface SRI1
    data Lidar_Object_Distance: type=uint32, init-value=10
    data Lidar_Object_ID: sw-impl-policy=QUEUED, type=uint16, init-value=11
    data Lidar_Object_Angle: type=uint16, init-value=13
  application sw component type Lidar_SWC
    provide port Provider_Port: provided-interface=SRI1
  sensor actuator sw component type DashBoard
    require port Recived_port: required-interface=SRI1
